## kernel/ptag/Kconfig
```kconfig
config PTAG
	bool "Add a tag to a PID"
	default y
	---help---
	A system call that adds a tag to a process ID
```

## kernel/tagstat/Kconfig
```kconfig
config TAGSTAT
	bool "Read PID tags in /proc file"
	default y
	---help---
	Reads PID tags created by "ptag" into /proc/tagstat
```
